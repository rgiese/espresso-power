#include <WebServer.h>

#include <array>
#include <chrono>

//
// Types
//

enum class PowerSenseState { On, Off, Unknown };

enum class PowerState { Off, Heating, On, Unknown };

//
// Globals
//

WebServer g_HTTPD;

pin_t constexpr c_PowerRelayPin = D7;
pin_t constexpr c_PowerSensePin = A5;

std::array<PowerSenseState, 8> g_PowerSenseBuffer;
size_t g_idxPowerSenseBuffer = 0;

PowerState g_LastPowerState;
unsigned long g_TimeOfLastPowerStateChange;

//
// Forwards
//

PowerSenseState readPowerSensePin();
PowerState evaluatePowerSenseHistory();

void serveIndexPage(WebServer &server,
                    WebServer::ConnectionType const connectionType,
                    char *const rgUrlTail, bool const fTailComplete);
void servePowerCyclePage(WebServer &server,
                         WebServer::ConnectionType const connectionType,
                         char *const rgUrlTail, bool const fTailComplete);
void serveGrumpyBirdSVG(WebServer &server,
                        WebServer::ConnectionType const connectionType,
                        char *const rgUrlTail, bool const fTailComplete);

//
// Core particle loops
//

void setup() {
  // Configure state
  g_PowerSenseBuffer.fill(PowerSenseState::Unknown);

  g_LastPowerState = PowerState::Unknown;
  g_TimeOfLastPowerStateChange = millis();

  // Configure hardware
  pinMode(c_PowerRelayPin, OUTPUT);
  digitalWrite(c_PowerRelayPin, LOW);

  pinMode(c_PowerSensePin, INPUT);

  // Configure web server
  g_HTTPD.setDefaultCommand(&serveIndexPage);
  g_HTTPD.addCommand("powerCycle", &servePowerCyclePage);
  g_HTTPD.addCommand("grumpyBird.svg", &serveGrumpyBirdSVG);

  g_HTTPD.begin();
}

void loop() {
  // Process power sense
  static unsigned long s_LastMeasurementTime = 0;

  unsigned long const currentTime = millis();
  unsigned long const timeSinceLastMeasurement =
      currentTime - s_LastMeasurementTime;

  if (timeSinceLastMeasurement >= 100) {
    s_LastMeasurementTime = currentTime;

    // Update measurements
    PowerSenseState const latestPowerSenseState = readPowerSensePin();

    g_PowerSenseBuffer[g_idxPowerSenseBuffer] = latestPowerSenseState;

    g_idxPowerSenseBuffer =
        (g_idxPowerSenseBuffer + 1) % g_PowerSenseBuffer.size();

    // Check for changes
    PowerState const powerState = evaluatePowerSenseHistory();

    if (powerState != g_LastPowerState) {
      g_LastPowerState = powerState;
      g_TimeOfLastPowerStateChange = millis();
    }
  }

  // Process HTTPD
  g_HTTPD.processConnection();
}

//
// Hardware-related goop
//

PowerSenseState readPowerSensePin() {
  int const analogPowerSenseValue = analogRead(c_PowerSensePin);

  //
  // Thresholds determined experimentally:
  // - "on" seems to be around 2050
  // - "off" seems to be around 2120
  //
  if ((analogPowerSenseValue < 2000) || (analogPowerSenseValue > 2200)) {
    return PowerSenseState::Unknown;
  }

  if (analogPowerSenseValue < 2100) {
    return PowerSenseState::On;
  }

  return PowerSenseState::Off;
}

PowerState evaluatePowerSenseHistory() {
  size_t cMeasurements_On = 0;
  size_t cMeasurements_Off = 0;

  for (PowerSenseState const powerSenseState : g_PowerSenseBuffer) {
    switch (powerSenseState) {
    case PowerSenseState::On:
      ++cMeasurements_On;
      break;
    case PowerSenseState::Off:
      ++cMeasurements_Off;
      break;
    case PowerSenseState::Unknown:
    default:
      // If we're just starting up or having connectivity issues, don't guess
      return PowerState::Unknown;
    }
  }

  float const onToOffRatio = static_cast<float>(cMeasurements_On) /
                             (cMeasurements_On + cMeasurements_Off);

  if (onToOffRatio >= 0.9f) {
    return PowerState::On;
  }

  if (onToOffRatio <= 0.1f) {
    return PowerState::Off;
  }

  return PowerState::Heating;
}

constexpr char const *powerStateToString(enum PowerState powerState) {
  switch (powerState) {
  case PowerState::Off:
    return "off";
  case PowerState::Heating:
    return "heating";
  case PowerState::On:
    return "on";
  case PowerState::Unknown:
    return "updating...";
  default:
    return "Internal error";
  }
}

//
// Web-related goop
//

void buildPage(WebServer &server, bool const fIsWorking) {
  PowerState const powerState = evaluatePowerSenseHistory();

  char const *const rgPowerCycleCommand = "location.href='/powerCycle'";

  char const *const opacity_Available = "1";
  char const *const opacity_Dimmed = "0.3";

  bool const canTurnOn = (powerState == PowerState::Off);
  bool const canTurnOff =
      (powerState == PowerState::On) || (powerState == PowerState::Heating);

  std::chrono::milliseconds const timeSinceLastPowerStateChange(
      millis() - g_TimeOfLastPowerStateChange);

  server.println("<html>");

  // Head
  server.println("<head>");
  server.println("  <title>Espresso Power</title>");

  if (!fIsWorking) {
    // Refresh every five seconds
    server.println("  <meta http-equiv=\"refresh\" content=\"5\">");
  }

  server.println(
      "  <link rel=\"stylesheet\" "
      "href=\"https://unpkg.com/tachyons@4.10.0/css/tachyons.min.css\">");

  // Head > Script
  if (fIsWorking) {
    // Revert to main page in two seconds
    server.println("<script>");
    server.println(
        "window.setTimeout(function () { window.location = '/'; }, 3000);");
    server.println("</script>");
  }

  // Head
  server.println("</head>");

  // Body
  server.println("<body class=\"flex flex-column items-stretch tc bg-white "
                 "avenir f-subheadline\">");

  // Body > Status
  server.println("  <div class=\"w-100 pa3\">");
  server.printlnf("    <span><img class=\"w4\" src=\"grumpyBird.svg\" />'s "
                  "espresso machine is </span><span class=\"b\">%s</span>",
                  fIsWorking ? "working..." : powerStateToString(powerState));
  server.println("  </div>");

  if (!fIsWorking) {
    // We should really do this with MomentJS on the client but whatever.
    using namespace std::chrono;
    using days = duration<int, std::ratio<86400>>;

    auto remainingTime = timeSinceLastPowerStateChange;

    auto cDays = duration_cast<days>(remainingTime);
    remainingTime -= cDays;

    auto cHours = duration_cast<hours>(remainingTime);
    remainingTime -= cHours;

    auto cMinutes = duration_cast<minutes>(remainingTime);
    remainingTime -= cMinutes;

    auto cSeconds = duration_cast<seconds>(remainingTime);

    auto const printValueWithUnits =
        [&server](int const value, char const *const unitName,
                  size_t const cPrecedingUnits, size_t const cRemainingUnits) {
          if (value > 0) {
            server.printf("%d %s%s", value, unitName, value > 1 ? "s" : "");

            if (cRemainingUnits == 1) {
              if (cPrecedingUnits > 1) {
                server.print(",");
              }

              server.print(" and ");
            } else if (cRemainingUnits > 1) {
              server.print(", ");
            }
          }
        };

    server.println("  <div class=\"w-100 pa3 f1\">and has been so for ");

    printValueWithUnits(cDays.count(), "day", 0,
                        !!(cHours.count()) + !!(cMinutes.count()) +
                            !!(cSeconds.count()));

    printValueWithUnits(cHours.count(), "hour", !!(cHours.count()),
                        !!(cMinutes.count()) + !!(cSeconds.count()));

    printValueWithUnits(cMinutes.count(), "minute",
                        !!(cHours.count()) + !!(cMinutes.count()),
                        !!(cSeconds.count()));

    printValueWithUnits(
        cSeconds.count(), "second",
        !!(cHours.count()) + !!(cMinutes.count()) + !!(cSeconds.count()), 0);

    server.println(".");

    server.println("  </div>");
  }

  // Body > On button
  server.println("  <div class=\"w-100 pa4\">");
  server.printlnf(
      "    <button id=\"buttonOn\" class=\"br3 pv3 ph6 white bg-green\" "
      "onClick=\"%s\" style=\"opacity: %s;\">Turn On</button>",
      canTurnOn ? rgPowerCycleCommand : "",
      canTurnOn ? opacity_Available : opacity_Dimmed);
  server.println("  </div>");

  // Body > Off button
  server.println("  <div class=\"w-100 pa4\">");
  server.printlnf("    <button class=\"br3 pv3 ph6 white bg-dark-red\" "
                  "onClick=\"%s\" style=\"opacity: %s;\">Turn Off</button>",
                  canTurnOff ? rgPowerCycleCommand : "",
                  canTurnOff ? opacity_Available : opacity_Dimmed);
  server.println("  </div>");

  // Body
  server.println("</body>");

  server.println("</html>");
}

void serveIndexPage(WebServer &server,
                    WebServer::ConnectionType const connectionType,
                    char *const rgUrlTail, bool const fTailComplete) {
  // Serve page
  server.httpSuccess();

  if (connectionType == WebServer::HEAD) {
    return;
  }

  buildPage(server, false /* not working */);
}

void servePowerCyclePage(WebServer &server,
                         WebServer::ConnectionType const connectionType,
                         char *const rgUrlTail, bool const fTailComplete) {
  // Reset state
  g_PowerSenseBuffer.fill(PowerSenseState::Unknown);

  // Serve page
  server.httpSuccess();

  if (connectionType == WebServer::HEAD) {
    return;
  }

  buildPage(server, true /* working */);

  // Push power button
  digitalWrite(c_PowerRelayPin, HIGH);

  // Wait
  delay(500);

  // Release power button
  digitalWrite(c_PowerRelayPin, LOW);
}

void serveGrumpyBirdSVG(WebServer &server,
                        WebServer::ConnectionType const connectionType,
                        char *const rgUrlTail, bool const fTailComplete) {
  // https://github.com/rgiese/www-grumpycorp-com/blob/master/src/assets/icons/grumpy-robin.svg
  unsigned char const rgData[] = {
      0x3C, 0x73, 0x76, 0x67, 0x20, 0x78, 0x6D, 0x6C, 0x6E, 0x73, 0x3D, 0x22,
      0x68, 0x74, 0x74, 0x70, 0x3A, 0x2F, 0x2F, 0x77, 0x77, 0x77, 0x2E, 0x77,
      0x33, 0x2E, 0x6F, 0x72, 0x67, 0x2F, 0x32, 0x30, 0x30, 0x30, 0x2F, 0x73,
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      0x3C, 0x2F, 0x73, 0x76, 0x67, 0x3E};

  server.httpSuccess("image/svg+xml",
                     "Cache-Control: public, max-age=604800, immutable");

  if (connectionType == WebServer::GET) {
    server.writeP(rgData, sizeof(rgData));
  }
}
